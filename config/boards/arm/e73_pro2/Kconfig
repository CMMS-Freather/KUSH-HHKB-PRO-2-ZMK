## config/boards/arm/e73_pro2/Kconfig
```kconfig
# SPDX-License-Identifier: MIT

config BOARD_ENABLE_DCDC
    bool "Enable DCDC mode"
    select SOC_DCDC_NRF52X
    default y
    depends on BOARD_E73_PRO2

config BOARD_ENABLE_DCDC_HV
    bool "Enable High Voltage DCDC converter"
    default y
    select SOC_DCDC_NRF52X_HV
    depends on BOARD_E73_PRO2
```

## config/boards/arm/e73_pro2/Kconfig.board
```kconfig
# Copyright (c) 2023 Kan-Ru Chen
# SPDX-License-Identifier: MIT

config BOARD_E73_PRO2
    bool "E73 Pro2"
    depends on SOC_NRF52840_QIAA
```

## config/boards/arm/e73_pro2/Kconfig.defconfig
```kconfig
# Copyright (c) 2023 Kan-Ru Chen
# SPDX-License-Identifier: MIT

if BOARD_E73_PRO2

config ZMK_KEYBOARD_NAME
    default "E73 Pro2 Rev A"

config BOARD
    default "e73_pro2"

if USB_DEVICE_STACK

config USB_NRFX
    default y

endif # USB_DEVICE_STACK

config BT_CTLR
    default BT

config ZMK_BLE
    default y

config ZMK_USB
    default y

endif # BOARD_E73_PRO2
```

## config/boards/shields/hhkb_pro2/Kconfig.shield
```kconfig
config SHIELD_HHKB_PRO2
    def_bool $(shields_list_contains,hhkb_pro2)
    depends on KSCAN_HHKB_PRO2

    # No whitespace after the comma or in the keyboard name!
config SHIELD_HHKB_PRO2_DONGLE
    def_bool $(shields_list_contains,hhkb_pro2_dongle)
```

## config/boards/shields/hhkb_pro2_dongle/Kconfig.shield
```kconfig
config SHIELD_HHKB_PRO2_DONGLE
    def_bool $(shields_list_contains,hhkb_pro2_dongle)
```
